hm: homerow_mods {
	compatible = "zmk,behavior-hold-tap";
	label = "HOMEROW_MODS";
	#binding-cells = <2>;
	flavor = "tap-preferred";
	tapping-term-ms = <180>;
	require-prior-idle-ms = <100>;
	bindings = <&kp>, <&kp>;
};

