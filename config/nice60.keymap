/*
 * Copyright (c) 2021 Nick Winans
 *
 * SPDX-License-Identifier: MIT
 */

#include <behaviors.dtsi>
#include <dt-bindings/zmk/keys.h>
#include <dt-bindings/zmk/bt.h>
#include <dt-bindings/zmk/outputs.h>
#include <dt-bindings/zmk/reset.h>
#include <dt-bindings/zmk/ext_power.h>

#define t___ &trans
#define DEF_L 0
#define NOH_L 1
#define NAV_L 2
#define NUM_L 3
#define APP_L 4
#define KBD_L 5
#define LCK_L 6

/ {
	behaviors {
#include "behaviors.dtsi"
	};

	combos {
#include "combos.dtsi"
	};

	keymap {
#include "keymap.dtsi"
	};
};

#undef t___
#undef DEF_L
#undef NOH_L
#undef NAV_L
#undef NUM_L
#undef APP_L
#undef KBD_L
#undef LCK_L

